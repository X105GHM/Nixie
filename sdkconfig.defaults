## sdkconfig.defaults
```kconfig
CONFIG_AUTOSTART_ARDUINO=y

DCONFIG_FREERTOS_GENERATE_RUN_TIME_STATS=1
DCONFIG_FREERTOS_USE_STATS_FORMATTING_FUNCTIONS=1
DCONFIG_FREERTOS_USE_IDLE_HOOK=1
DCONFIG_FREERTOS_USE_TRACE_FACILITY=1
DCONFIG_FREERTOS_GENERATE_RUN_TIME_STATS=1
DCONFIG_FREERTOS_RUN_TIME_STATS_USING_ESP_TIMER=1
DCONFIG_FREERTOS_USE_STATS_FORMATTING_FUNCTIONS=1
DCONFIG_FREERTOS_VTASKLIST_INCLUDE_COREID=1

CONFIG_FREERTOS_CHECK_STACKOVERFLOW=2
```
